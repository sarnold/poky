## meta-poky/conf/distro/poky-musl.conf
```bitbake
# Distribution definition for: poky-musl
#

require conf/distro/poky.conf

DISTRO = "poky-musl"

# Distro config is evaluated after the machine config, so we have to explicitly
# set the kernel provider to override a machine config.
PREFERRED_PROVIDER_virtual/kernel ?= "linux-armv7multi"
#PREFERRED_VERSION_linux-armv7multi ?= "4.18%"
PREFERRED_PROVIDER_virtual/bootloader ?= "u-boot"
#PREFERRED_VERSION_virtual/bootloader ?= "2018.11%"

POKY_DEFAULT_EXTRA_RDEPENDS += "packagegroup-core-boot"

TCLIBC = "musl"
# FIXME: what should we do with this?
TCLIBCAPPEND = ""

# Disable wide char support for ncurses as we don't include it in
# in the LIBC features below.
# Leave native enable to avoid build failures
ENABLE_WIDEC = "false"
ENABLE_WIDEC_class-native = "true"

# Drop native language support. This removes the
# eglibc->bash->gettext->libc-posix-clang-wchar dependency.
USE_NLS="no"

POKY_DEFAULT_DISTRO_FEATURES = "ipv4 ipv6 pci ptest multiarch sysvinit usbhost usbgadget"

DISTRO_FEATURES ?= "${DISTRO_FEATURES_DEFAULT} ${DISTRO_FEATURES_LIBC} ${POKY_DEFAULT_DISTRO_FEATURES}"

# Enable LFS - see bug YOCTO #5865
DISTRO_FEATURES_append_libc-musl = " largefile"

DISTRO_FEATURES_class-native = "${DISTRO_FEATURES_DEFAULT} ${DISTRO_FEATURES_LIBC} ${POKY_DEFAULT_DISTRO_FEATURES}"
DISTRO_FEATURES_class-nativesdk = "${DISTRO_FEATURES_DEFAULT} ${DISTRO_FEATURES_LIBC} ${POKY_DEFAULT_DISTRO_FEATURES}"

VIRTUAL-RUNTIME_dev_manager ??= "udev"
VIRTUAL-RUNTIME_login_manager ??= "busybox"
VIRTUAL-RUNTIME_init_manager ??= "sysvinit"
VIRTUAL-RUNTIME_initscripts ??= "initscripts"
VIRTUAL-RUNTIME_keymaps ??= "keymaps"

PREFERRED_PROVIDER_virtual/egl ?= "mesa"
PREFERRED_PROVIDER_virtual/libgl ?= "mesa"
PREFERRED_PROVIDER_virtual/libgles1 ?= "mesa"
PREFERRED_PROVIDER_virtual/libgles2 ?= "mesa"
PREFERRED_PROVIDER_virtual/libg2d ?= "mesa"

PREFERRED_PROVIDER_jpeg ?= "libjpeg-turbo"
PREFERRED_PROVIDER_jpeg-native ?= "libjpeg-turbo-native"

# most of these are set in rpi/machine/include/rpi-default-providers.inc
PREFERRED_PROVIDER_xserver_common ?= "x11-common"

DISTRO_FEATURES_append = " opengl"
DISTRO_FEATURES_BACKFILL_CONSIDERED ?= "multiarch pulseaudio systemd"

#LOCALE_UTF8_ONLY = "1"
#LOCALE_UTF8_IS_DEFAULT = "1"
IMAGE_LINGUAS = "en-us en-gb de-de fr-fr es-mx pt-br it-it"
#LIMIT_BUILT_LOCALES = "POSIX en_US en_GB de_DE fr_FR es_MX pt_BR it_IT"

COMMERCIAL_AUDIO_PLUGINS = "gst-plugins-ugly-mad gst-plugins-ugly-mpegaudioparse"
COMMERCIAL_VIDEO_PLUGINS = "gst-plugins-ugly-mpeg2dec gst-plugins-ugly-mpegstream gst-plugins-bad-mpegvideoparse"

# The mtrace script included by eglibc is a perl script. This means the system
# will build perl in case this package is installed. Since we don't care about
# this script for the purposes of tiny, remove the dependency from here.
RDEPENDS_${PN}-mtrace_pn-eglibc = ""
```
